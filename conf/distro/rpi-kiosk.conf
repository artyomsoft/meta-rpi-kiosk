## conf/distro/rpi-kiosk.conf
```bitbake
require conf/distro/poky.conf

DISTRO = "rpi-kiosk"
DISTRO_NAME = "Raspberry Pi Zero 2 W Kiosk"

LICENSE_FLAGS_ACCEPTED += "synaptics-killswitch"
IMAGE_INSTALL:append = " nu-pogodi kernel-modules"
```
